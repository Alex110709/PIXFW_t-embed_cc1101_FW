## sdkconfig.defaults
```kconfig
# T-Embed CC1101 Firmware Configuration

#
# Serial flasher config
#
CONFIG_ESPTOOLPY_FLASHMODE_QIO=y
CONFIG_ESPTOOLPY_FLASHFREQ_80M=y
CONFIG_ESPTOOLPY_FLASHSIZE_16MB=y

#
# Partition Table
#
CONFIG_PARTITION_TABLE_CUSTOM=y
CONFIG_PARTITION_TABLE_CUSTOM_FILENAME="partitions.csv"

#
# ESP32S3-Specific
#
CONFIG_ESP32S3_DEFAULT_CPU_FREQ_240=y
CONFIG_ESP32S3_SPIRAM_SUPPORT=y
CONFIG_SPIRAM_MODE_OCT=y
CONFIG_SPIRAM_TYPE_ESPPSRAM64=y
CONFIG_SPIRAM_SIZE=8388608

#
# FreeRTOS
#
CONFIG_FREERTOS_HZ=1000
CONFIG_FREERTOS_USE_TRACE_FACILITY=y
CONFIG_FREERTOS_GENERATE_RUN_TIME_STATS=y

#
# JavaScript Engine (mJS)
#
CONFIG_MJS_ENABLE=y
CONFIG_MJS_MEMORY_LIMIT=65536
CONFIG_MJS_STACK_SIZE=4096

#
# LVGL Configuration
#
CONFIG_LV_COLOR_DEPTH_16=y
CONFIG_LV_DPI_DEF=130
CONFIG_LV_MEM_CUSTOM=y
CONFIG_LV_MEM_SIZE=131072

#
# Wi-Fi
#
CONFIG_ESP32_WIFI_STATIC_RX_BUFFER_NUM=10
CONFIG_ESP32_WIFI_DYNAMIC_RX_BUFFER_NUM=32
CONFIG_ESP32_WIFI_TX_BUFFER_TYPE_DYNAMIC=y
CONFIG_ESP32_WIFI_DYNAMIC_TX_BUFFER_NUM=32

#
# File System
#
CONFIG_SPIFFS_MAX_PARTITIONS=3
CONFIG_SPIFFS_USE_MAGIC=y
CONFIG_SPIFFS_USE_MAGIC_LENGTH=y

#
# HTTP Server
#
CONFIG_HTTPD_MAX_REQ_HDR_LEN=2048
CONFIG_HTTPD_MAX_URI_LEN=1024

#
# Component config
#
CONFIG_CC1101_SPI_HOST=SPI2_HOST
CONFIG_CC1101_PIN_MOSI=35
CONFIG_CC1101_PIN_MISO=37
CONFIG_CC1101_PIN_CLK=36
CONFIG_CC1101_PIN_CS=34
CONFIG_CC1101_PIN_GDO0=33
CONFIG_CC1101_PIN_GDO2=21
```
